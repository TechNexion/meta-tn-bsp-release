## conf/machine/tek-imx8mp.conf
```bitbake
#@TYPE: Machine
#@NAME: TEK-IMX8MP
#@SOC: i.MX8MP
#@DESCRIPTION: Machine configuration for TechNexion TEK-IMX8MP
#@MAINTAINER: Wig Cheng <wig.cheng@technexion.com>

MACHINEOVERRIDES =. "imx-boot-container:mx8mp:"

require conf/machine/include/imx-base.inc
require conf/machine/include/arm/armv8a/tune-cortexa53.inc
require conf/machine/tn-base.inc

# Kernel specifics
KERNEL_DEVICETREE = " \
                    freescale/imx8mp-tek.dtb \
                    freescale/imx8mp-tek-rpmsg.dtb \
                    freescale/overlays/imx8mp-tek-hdmi2mipi-tc358743.dtbo \
                    freescale/overlays/imx8mp-tek-vls.dtbo \
"

EXTRA_OEMAKE:append:pn-linux-tn-imx = " DTC_FLAGS='-@ -H epapr'"

# U-boot specifics
UBOOT_CONFIG = "sd fspi"
UBOOT_CONFIG[sd] = "tek-imx8mp_defconfig,sdcard"
UBOOT_CONFIG[fspi] = "tek-imx8mp_defconfig"
UBOOT_CONFIG[mfgtool] = "tek-imx8mp_defconfig"
UBOOT_DTB_NAME = "imx8mp-tek.dtb"

ATF_PLATFORM = "imx8mp"
ATF_LOAD_ADDR = "0x970000"
# Extra firmware package name, that is required to build boot container for fslc bsp
IMX_EXTRA_FIRMWARE = "firmware-imx-8m"
IMX_BOOT_SOC_TARGET = "iMX8MP"
IMX_BOOT_SEEK:tek-imx8mp = "32"

# Set Serial console
SERIAL_CONSOLES = "115200;ttymxc1"

BOOT_SPACE = "65536"

# Set DDR FIRMWARE
DDR_FIRMWARE_NAME:mx8-nxp-bsp = "lpddr4_pmu_train_1d_dmem_202006.bin lpddr4_pmu_train_1d_imem_202006.bin lpddr4_pmu_train_2d_dmem_202006.bin lpddr4_pmu_train_2d_imem_202006.bin"

# WIC Image
M7_MACHINE = "tek-imx8mp"
WKS_FILE_DEPENDS:append = " imx-m7-demos-tn u-boot-fspi-image"
IMAGE_BOOTFILES += "hello_world.bin \
                    tek-imx8mp_fspi_u-boot.bin \
"
WKS_FILE:virtualization = "tn-imx8-imxboot-rootfs-container.wks.in"
WIC_FSTAB_BLKDEV = "mmcblk2"
WIC_CREATE_EXTRA_ARGS:remove:virtualization = "--no-fstab-update"
WIC_PARTITION_TABLE_TYPE ?= "msdos"
IMAGE_FSTYPES:append:virtualization = " wic wic.xz wic.md5sum"
IMAGE_FSTYPES:remove:virtualization = " sdcard sdcard.bz2 sdcard.xz sdcard.md5sum"
IMAGE_BOOT_FILES += "\
    ${IMAGE_BOOTFILES} \
"

IMAGE_INSTALL:append = " se050-tools lpc802-lanbypass power-key-listener enable-lanbypass-eth"
IMAGE_INSTALL:remove = " bluetooth wifi"

# virtualization - docker containers
#DOCKERDISKDEPENDS = "${@bb.utils.contains('DISTRO_FEATURES', 'virtualization', 'docker-disk:do_deploy', '', d)}"
#do_image_wic[depends] += "${DOCKERDISKDEPENDS}"
#TN_DOCKER_PARTITION_IMAGE = "docker-data-partition.img"
#TN_DOCKER_PARTITION_MOUNT = "/var/lib/docker"
#TN_DOCKER_PARTITION_SIZE = "4096"
```

## conf/machine/tek3-imx8mp.conf
```bitbake
#@TYPE: Machine
#@NAME: EDM-G-IMX8MP
#@SOC: i.MX8MM
#@DESCRIPTION: Machine configuration for TechNexion TEK3-IMX8MP
#@MAINTAINER: Wig Cheng <wig.cheng@technexion.com>

MACHINEOVERRIDES =. "imx-boot-container:mx8mp:"

require conf/machine/include/imx-base.inc
require conf/machine/include/arm/armv8a/tune-cortexa53.inc
require conf/machine/tn-base.inc

# Kernel specifics
KERNEL_DEVICETREE = " \
                    freescale/imx8mp-tek3.dtb \
                    freescale/imx8mp-tek3-rpmsg.dtb \
                    freescale/overlays/imx8mp-tek3-hdmi2mipi-tc358743.dtbo \
                    freescale/overlays/imx8mp-tek3-vizionlink-tevi-ov5640.dtbo \
                    freescale/overlays/imx8mp-tek3-vizionlink-tevi-ap1302.dtbo \
"

EXTRA_OEMAKE:append:pn-linux-tn-imx = " DTC_FLAGS='-@ -H epapr'"

# U-boot specifics
UBOOT_CONFIG = "sd fspi"
UBOOT_CONFIG[sd] = "tek3-imx8mp_defconfig,sdcard"
UBOOT_CONFIG[fspi] = "tek3-imx8mp_defconfig"
UBOOT_CONFIG[mfgtool] = "tek3-imx8mp_defconfig"
UBOOT_DTB_NAME = "imx8mp-tek3.dtb"

ATF_PLATFORM = "imx8mp"
ATF_LOAD_ADDR = "0x970000"
# Extra firmware package name, that is required to build boot container for fslc bsp
IMX_EXTRA_FIRMWARE = "firmware-imx-8m"
IMX_BOOT_SOC_TARGET = "iMX8MP"
IMX_BOOT_SEEK:tek3-imx8mp = "32"

# Set Serial console
SERIAL_CONSOLES = "115200;ttymxc1"

BOOT_SPACE = "65536"

# Set DDR FIRMWARE
DDR_FIRMWARE_NAME:mx8-nxp-bsp = "lpddr4_pmu_train_1d_dmem_202006.bin lpddr4_pmu_train_1d_imem_202006.bin lpddr4_pmu_train_2d_dmem_202006.bin lpddr4_pmu_train_2d_imem_202006.bin"

# WIC Image
M7_MACHINE = "tek3-imx8mp"
WKS_FILE_DEPENDS:append = " imx-m7-demos-tn u-boot-fspi-image"
IMAGE_BOOTFILES += "hello_world.bin \
                    tek3-imx8mp_fspi_u-boot.bin \
"
WKS_FILE:virtualization = "tn-imx8-imxboot-rootfs-container.wks.in"
WIC_FSTAB_BLKDEV = "mmcblk2"
WIC_CREATE_EXTRA_ARGS:remove:virtualization = "--no-fstab-update"
WIC_PARTITION_TABLE_TYPE ?= "msdos"
IMAGE_FSTYPES:append:virtualization = " wic wic.xz wic.md5sum"
IMAGE_FSTYPES:remove:virtualization = " sdcard sdcard.bz2 sdcard.xz sdcard.md5sum"
IMAGE_BOOT_FILES += "\
    ${IMAGE_BOOTFILES} \
"

IMAGE_INSTALL:append = " se050-tools lpc802-lanbypass power-key-listener"
IMAGE_INSTALL:remove = " bluetooth wifi"

# virtualization - docker containers
#DOCKERDISKDEPENDS = "${@bb.utils.contains('DISTRO_FEATURES', 'virtualization', 'docker-disk:do_deploy', '', d)}"
#do_image_wic[depends] += "${DOCKERDISKDEPENDS}"
#TN_DOCKER_PARTITION_IMAGE = "docker-data-partition.img"
#TN_DOCKER_PARTITION_MOUNT = "/var/lib/docker"
#TN_DOCKER_PARTITION_SIZE = "4096"
```

## conf/machine/tep-imx8mp.conf
```bitbake
#@TYPE: Machine
#@NAME: TEP-IMX8MP
#@SOC: i.MX8MP
#@DESCRIPTION: Machine configuration for TechNexion TEP-IMX8MP
#@MAINTAINER: Joe Zhang <joe.zhang@technexion.com>

MACHINEOVERRIDES =. "imx-boot-container:mx8mp:"

require conf/machine/include/imx-base.inc
require conf/machine/include/arm/armv8a/tune-cortexa53.inc
require conf/machine/tn-base.inc

# Kernel specifics
KERNEL_DEVICETREE = " \
			freescale/imx8mp-tep.dtb \
			freescale/imx8mp-tep-rpmsg.dtb \
		    freescale/overlays/imx8mp-tep-lvds-vl10112880.dtbo \
		    freescale/overlays/imx8mp-tep-lvds-vl15010276.dtbo \
		    freescale/overlays/imx8mp-tep-lvds-vl156192108.dtbo \
		    freescale/overlays/imx8mp-tep-lvds-vl215192108.dtbo \
		    freescale/overlays/imx8mp-tep-vizionlink-tevi-ap1302.dtbo \
		    freescale/overlays/imx8mp-tep-vizionlink-tevi-ov5640.dtbo \
		    freescale/overlays/imx8mp-tep-vls.dtbo \
		    freescale/overlays/imx8mp-tep-hdmi2mipi-tc358743.dtbo \
		    freescale/overlays/imx8mp-tep-vizionpanel-vl10112880.dtbo \
		    freescale/overlays/imx8mp-tep-vizionpanel-vl15010276.dtbo \
		    freescale/overlays/imx8mp-tep-vizionpanel-vl215192108.dtbo \
"

EXTRA_OEMAKE:append:pn-linux-tn-imx = " DTC_FLAGS='-@ -H epapr'"

# U-boot specifics
UBOOT_CONFIG = "sd fspi"
UBOOT_CONFIG[sd] = "tep-imx8mp_defconfig,sdcard"
UBOOT_CONFIG[fspi] = "tep-imx8mp_defconfig"
UBOOT_CONFIG[mfgtool] = "tep-imx8mp_defconfig"
UBOOT_DTB_NAME = "imx8mp-tep.dtb"

ATF_PLATFORM = "imx8mp"
ATF_LOAD_ADDR = "0x970000"
# Extra firmware package name, that is required to build boot container for fslc bsp
IMX_EXTRA_FIRMWARE = "firmware-imx-8m"
IMX_BOOT_SOC_TARGET = "iMX8MP"
IMX_BOOT_SEEK:tep-imx8mp = "32"

# Set Serial console
SERIAL_CONSOLES = "115200;ttymxc1"

BOOT_SPACE = "65536"

# Set DDR FIRMWARE
DDR_FIRMWARE_NAME:mx8-nxp-bsp = "lpddr4_pmu_train_1d_dmem_202006.bin lpddr4_pmu_train_1d_imem_202006.bin lpddr4_pmu_train_2d_dmem_202006.bin lpddr4_pmu_train_2d_imem_202006.bin"

# WIC Image
M7_MACHINE = "tep-imx8mp"
WKS_FILE_DEPENDS:append = " imx-m7-demos-tn u-boot-fspi-image"
IMAGE_BOOTFILES += "hello_world.bin \
                    tep-imx8mp_fspi_u-boot.bin \
"
WKS_FILE:virtualization = "tn-imx8-imxboot-rootfs-container.wks.in"
WIC_FSTAB_BLKDEV = "mmcblk2"
WIC_CREATE_EXTRA_ARGS:remove:virtualization = "--no-fstab-update"
WIC_PARTITION_TABLE_TYPE ?= "msdos"
IMAGE_FSTYPES:append:virtualization = " wic wic.xz wic.md5sum"
IMAGE_FSTYPES:remove:virtualization = " sdcard sdcard.bz2 sdcard.xz sdcard.md5sum"
IMAGE_BOOT_FILES += "\
    ${IMAGE_BOOTFILES} \
"

IMAGE_INSTALL:append = " se050-tools lpc802-lanbypass enable-lanbypass-eth"
IMAGE_INSTALL:remove = " bluetooth wifi"

# virtualization - docker containers
#DOCKERDISKDEPENDS = "${@bb.utils.contains('DISTRO_FEATURES', 'virtualization', 'docker-disk:do_deploy', '', d)}"
#do_image_wic[depends] += "${DOCKERDISKDEPENDS}"
#TN_DOCKER_PARTITION_IMAGE = "docker-data-partition.img"
#TN_DOCKER_PARTITION_MOUNT = "/var/lib/docker"
#TN_DOCKER_PARTITION_SIZE = "4096"
```

## conf/machine/tep1-imx7.conf
```bitbake
#@TYPE: Machine
#@NAME: tep1-imx7
#@SOC: i.MX7/Solo/Dual/UtraLowPower
#@DESCRIPTION: Machine configuration for TEP1-IMX7
#@MAINTAINER: Ray Chang <ray.chang@technexion.com>

MACHINEOVERRIDES =. "mx7:mx7d:"

include conf/machine/include/imx-base.inc
include conf/machine/include/arm/armv7a/tune-cortexa7.inc
require conf/machine/tn-base.inc

# Kernel Device Trees
KERNEL_DEVICETREE = "imx7d-tep1.dtb imx7d-tep1-a2.dtb"

# Bootloader Specifics
UBOOT_MACHINE = "tep1-imx7d_spl_defconfig"

#M4_MACHINE = "tep1-imx7"
#IMAGE_BOOTFILES_DEPENDS += "imx-m4-demos-tn:do_deploy"
#IMAGE_BOOTFILES += "hello_world.bin rpmsg_lite_pingpong_rtos_linux_remote.bin rpmsg_lite_str_echo_rtos_imxcm4.bin"

# MESA DRI library
XSERVER += "mesa-driver-swrast"

# Peripherals
# Set Serial console
SERIAL_CONSOLE = "115200;ttymxc1"

# WIC Image
WIC_FSTAB_BLKDEV = "mmcblk2"
#WIC_CREATE_EXTRA_ARGS = "--no-fstab-update"
WIC_PARTITION_TABLE_TYPE ?= "msdos"
IMAGE_FSTYPES:append = " wic"
IMAGE_BOOT_FILES = "\
    ${KERNEL_IMAGETYPE} \
    ${KERNEL_DEVICETREE} \
    u-boot-${MACHINE}.${UBOOT_SUFFIX};u-boot-dtb.img \
"


# UBOOT entry address for fitImages
UBOOT_ENTRYPOINT:tep1-imx7 = "0x80800000"
UBOOT_RD_ENTRYPOINT:tep1-imx7 = "0x83800000"
UBOOT_RD_LOADADDRESS:tep1-imx7 = "0x83800000"
UBOOT_FDT_LOADADDRESS:rescue = "0x83000000"
UBOOT_FDTOV_LOADADDRESS:rescue = "0x82FE00000"
```
