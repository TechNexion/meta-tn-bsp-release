## conf/machine/pico-imx8mq.conf
```bitbake
#@TYPE: Machine
#@NAME: PICO-IMX8M
#@SOC: i.MX8MQ
#@DESCRIPTION: Machine configuration for PICO-IMX8MQ
#@MAINTAINER: Richard Hu <richard.hu@technexion.com>

MACHINEOVERRIDES =. "mx8:mx8m:mx8mq:"

require conf/machine/include/imx-base.inc
require conf/machine/include/tune-cortexa53.inc
require conf/machine/tn-base.inc

# Kernel Device Trees
KERNEL_DEVICETREE:pico-imx8mq = "freescale/imx8mq-pico-pi.dtb \
				 freescale/imx8mq-pico-wizard.dtb \
				 freescale/overlays/imx8mq-pico-pi-ili9881c.dtbo \
				 freescale/overlays/imx8mq-pico-pi-dual.dtbo \
				 freescale/overlays/imx8mq-pico-pi-tevi-ov5640.dtbo \
				 freescale/overlays/imx8mq-pico-pi-ov5645.dtbo \
				 freescale/overlays/imx8mq-pico-pi-ov7251.dtbo \
				 freescale/overlays/imx8mq-pico-wizard-ili9881c.dtbo \
				 freescale/overlays/imx8mq-pico-wizard-g080uan01.dtbo \
				 freescale/overlays/imx8mq-pico-wizard-g101uan02.dtbo \
				 freescale/overlays/imx8mq-pico-wizard-sn65dsi84-vl10112880.dtbo \
				 freescale/overlays/imx8mq-pico-wizard-sn65dsi84-vl15613676.dtbo \
				 freescale/overlays/imx8mq-pico-wizard-sn65dsi84-vl215192108.dtbo \
				 freescale/overlays/imx8mq-pico-wizard-mipi2hdmi-adv7535.dtbo \
				 freescale/overlays/imx8mq-pico-wizard-tevi-ov5640.dtbo \
				 freescale/overlays/imx8mq-pico-wizard-ov5645.dtbo \
				 freescale/overlays/imx8mq-pico-wizard-ov7251.dtbo \
				"
#                     freescale/imx8mq-pico-pi-m4.dtb \
#"
# Setup the additional devicetree file
KERNEL_DEVICETREE:append:voicehat = " freescale/overlays/imx8mq-pico-pi-voicehat.dtbo \
				      freescale/overlays/imx8mq-pico-wizard-voicehat.dtbo"

KERNEL_DEVICETREE:append:nfc = " freescale/overlays/imx8mq-pico-pi-clixnfc.dtbo \
				 freescale/overlays/imx8mq-pico-wizard-clix1nfc.dtbo \
				 freescale/overlays/imx8mq-pico-wizard-clix2nfc.dtbo"

EXTRA_OEMAKE:append:pn-linux-tn-imx = " DTC_FLAGS='-@ -H epapr'"

M4_MACHINE = "pico-imx8mq-pi"
do_image_wic[depends] += "imx-m4-demos-tn:do_deploy"
IMAGE_BOOTFILES += "hello_world.bin rpmsg_lite_pingpong_rtos_linux_remote.bin rpmsg_lite_str_echo_rtos_imxcm4.bin"

# Bootloader Specifics
UBOOT_CONFIG[sd] = "pico-imx8mq_defconfig,sdcard"
UBOOT_CONFIG[mfgtool] = "pico-imx8mq_defconfig"

# Set u-boot DTB
UBOOT_DTB_NAME = "imx8mq-pico-pi.dtb imx8mq-pico-wizard.dtb"

# Set ATF platform name
ATF_PLATFORM = "imx8mq"

# Set imx-mkimage boot target
IMX_BOOT_SOC_TARGET = "iMX8M"

# Peripherals
# Set Serial console
SERIAL_CONSOLES = "115200;ttymxc0"
SERIAL_BLUETOOTH = "3000000;ttymxc1"

# WIC Image
WKS_FILE:virtualization = "tn-imx8-imxboot-rootfs-container.wks.in"
WIC_FSTAB_BLKDEV = "mmcblk0"
WIC_CREATE_EXTRA_ARGS:remove:virtualization = "--no-fstab-update"
WIC_PARTITION_TABLE_TYPE ?= "msdos"
IMAGE_FSTYPES:append:virtualization = " wic wic.xz wic.md5sum"
IMAGE_FSTYPES:remove:virtualization = " sdcard sdcard.bz2 sdcard.xz sdcard.md5sum"
IMAGE_BOOT_FILES += "\
    ${IMAGE_BOOTFILES} \
"

# virtualization - docker containers
#DOCKERDISKDEPENDS = "${@bb.utils.contains('DISTRO_FEATURES', 'virtualization', 'docker-disk:do_deploy', '', d)}"
#do_image_wic[depends] += "imx-m4-demos-tn:do_deploy ${DOCKERDISKDEPENDS}"
#TN_DOCKER_PARTITION_IMAGE = "docker-data-partition.img"
#TN_DOCKER_PARTITION_MOUNT = "/var/lib/docker"
#TN_DOCKER_PARTITION_SIZE = "4096"
```

## conf/machine/pico-imx93.conf
```bitbake
#@TYPE: Machine
#@NAME: TechNexion PICO-IMX93
#@SOC: NXP i.MX93
#@DESCRIPTION: Machine configuration for TechNexion i.MX 93 PICO board
#@MAINTAINER: Joe Zhange <joe.zhang@technexion.com>

MACHINEOVERRIDES =. "mx93:"

require conf/machine/include/imx-base.inc
require conf/machine/include/arm/armv8-2a/tune-cortexa55.inc
require conf/machine/tn-base.inc

# Kernel specifics
KERNEL_DEVICETREE = " \
		freescale/imx93-pico-wb.dtb \
		freescale/overlays/imx93-pico-wb-lvds-vl10112880.dtbo \
		freescale/overlays/imx93-pico-wb-lvds-vl15613676.dtbo \
		freescale/overlays/imx93-pico-wb-vxt-vl050-070-8048nt.dtbo \
		freescale/overlays/imx93-pico-wb-vxt-vl0808060nt.dtbo \
		freescale/overlays/imx93-pico-wb-mipi2hdmi-adv7535.dtbo \
		freescale/overlays/imx93-pico-wb-vizionpanel-vl10112880.dtbo \
		freescale/overlays/imx93-pico-wb-vizionpanel-vl808060.dtbo \
		freescale/overlays/imx93-pico-wb-tevs.dtbo \
		freescale/overlays/imx93-pico-wb-vls.dtbo \
		freescale/overlays/imx93-pico-wb-hdmi2mipi-tc358743.dtbo \
"
EXTRA_OEMAKE:append:pn-linux-tn-imx = " DTC_FLAGS='-@ -H epapr'"

# U-boot specifics
UBOOT_CONFIG = "sd"
UBOOT_CONFIG[sd] = "pico-imx93_defconfig,sdcard"
UBOOT_CONFIG[mfgtool] = "pico-imx93_defconfig"
UBOOT_DTB_NAME = "imx93-pico.dtb"

# Set ATF platform name
ATF_PLATFORM = "imx93"
IMXBOOT_TARGETS = "flash_singleboot"
IMX_BOOT_SOC_TARGET = "iMX9"
IMX_BOOT_SEEK:pico-imx93 = "32"

# Set Serial console
SERIAL_CONSOLES = "115200;ttyLP0"
SERIAL_BLUETOOTH = "3000000;ttyLP4"

DDR_FIRMWARE_NAME = " \
    lpddr4_dmem_1d_v202201.bin \
    lpddr4_dmem_2d_v202201.bin \
    lpddr4_imem_1d_v202201.bin \
    lpddr4_imem_2d_v202201.bin \
"
IMX_DEFAULT_BOOTLOADER:use-nxp-bsp = "u-boot-imx"
IMX_DEFAULT_BOOTLOADER:use-mainline-bsp = "u-boot-fslc"

# WIC Image
WIC_FSTAB_BLKDEV = "mmcblk0"
WIC_PARTITION_TABLE_TYPE ?= "msdos"
```

## conf/machine/sc-imx8mp.conf
```bitbake
#@TYPE: Machine
#@NAME: SC-IMX8MP
#@SOC: i.MX8MP
#@DESCRIPTION: Machine configuration for TechNexion SC-IMX8MP
#@MAINTAINER: Andy Lin <andy.lin@technexion.com>

MACHINEOVERRIDES =. "imx-boot-container:mx8mp:"

require conf/machine/include/imx-base.inc
require conf/machine/include/arm/armv8a/tune-cortexa53.inc
require conf/machine/tn-base.inc

# Kernel specifics
KERNEL_DEVICETREE = " freescale/imx8mp-sc.dtb"

# U-boot specifics
UBOOT_CONFIG = "sd"
UBOOT_CONFIG[sd] = "sc-imx8mp_defconfig,sdcard"
UBOOT_CONFIG[mfgtool] = "sc-imx8mp_defconfig"
UBOOT_DTB_NAME = "imx8mp-sc.dtb"

ATF_PLATFORM = "imx8mp"
ATF_LOAD_ADDR = "0x970000"
# Extra firmware package name, that is required to build boot container for fslc bsp
IMX_EXTRA_FIRMWARE = "firmware-imx-8m"
IMX_BOOT_SOC_TARGET = "iMX8MP"
IMX_BOOT_SEEK = "32"


# Set Serial console
SERIAL_CONSOLES = "115200;ttymxc1"
BOOT_SPACE = "65536"

# Set DDR FIRMWARE
DDR_FIRMWARE_NAME = "lpddr4_pmu_train_1d_dmem_202006.bin lpddr4_pmu_train_1d_imem_202006.bin lpddr4_pmu_train_2d_dmem_202006.bin lpddr4_pmu_train_2d_imem_202006.bin"

# WIC Image
WKS_FILE_DEPENDS:append = " imx-m7-demos"
WKS_FILE:virtualization = "tn-imx8-imxboot-rootfs-container.wks.in"
WIC_FSTAB_BLKDEV = "mmcblk2"
WIC_CREATE_EXTRA_ARGS:remove:virtualization = "--no-fstab-update"
WIC_PARTITION_TABLE_TYPE ?= "msdos"
IMAGE_FSTYPES:append:virtualization = " wic.xz wic.md5sum"
IMAGE_FSTYPES:remove:virtualization = " sdcard sdcard.bz2 sdcard.xz sdcard.md5sum"

# virtualization - docker containers
#DOCKERDISKDEPENDS = "${@bb.utils.contains('DISTRO_FEATURES', 'virtualization', 'docker-disk:do_deploy', '', d)}"
#do_image_wic[depends] += "${DOCKERDISKDEPENDS}"
#TN_DOCKER_PARTITION_IMAGE = "docker-data-partition.img"
#TN_DOCKER_PARTITION_MOUNT = "/var/lib/docker"
#TN_DOCKER_PARTITION_SIZE = "4096"

# UBOOT entry address for fitImages
UBOOT_ENTRYPOINT:sc-imx8mp= "0x40480000"
```

## conf/machine/tek-imx6.conf
```bitbake
#@TYPE: Machine
#@NAME: tek-imx6
#@SOC: i.MX6Q/Dual/DualLite/Solo/QuadPlus
#@DESCRIPTION: Machine configuration for TEK3, TEP/TWP series
#@MAINTAINER: Ray Chang <ray.chang@technexion.com>

MACHINEOVERRIDES =. "mx6:mx6dl:mx6q:"
MACHINEOVERRIDES_EXTENDER_tek-imx6 = "uenv"

include conf/machine/include/imx-base.inc
include conf/machine/include/tune-cortexa9.inc
require conf/machine/tn-base.inc

# Kernel Device Trees
KERNEL_DEVICETREE ?= "imx6dl-tek3.dtb imx6q-tek3.dtb \
                      imx6dl-tep5.dtb imx6q-tep5.dtb imx6dl-tep5-15inch.dtb imx6q-tep5-15inch.dtb"

# Bootloader Specifics
UBOOT_MACHINE = "tek-imx6_spl_defconfig"

# Peripherals
# Set Serial console
SERIAL_CONSOLE = "115200;ttymxc0"

# WIC Image
WIC_FSTAB_BLKDEV = "mmcblk2"
#WIC_CREATE_EXTRA_ARGS = "--no-fstab-update"
WIC_PARTITION_TABLE_TYPE ?= "msdos"
#IMAGE_FSTYPES_append = " wic"
IMAGE_BOOT_FILES = "\
	${KERNEL_IMAGETYPE} \
	${KERNEL_DEVICETREE} \
	u-boot-${MACHINE}.${UBOOT_SUFFIX};u-boot-dtb.img \
"

BOOT_SPACE_tek-imx6 = "16392"
# UBOOT entry address for fitImages
UBOOT_ENTRYPOINT_tek-imx6 = "0x12000000"
UBOOT_RD_ENTRYPOINT_tek-imx6 = "0x12C00000"
UBOOT_RD_LOADADDRESS_tek-imx6 = "0x12C00000"
UBOOT_FDT_LOADADDRESS_rescue = "0x12BE0000"
UBOOT_FDTOV_LOADADDRESS_rescue = "0x12BB0000"
```
