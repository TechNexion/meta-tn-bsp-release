## conf/machine/edm-g-imx8mn.conf
```bitbake
#@TYPE: Machine
#@NAME: EDM-G-IMX8M
#@SOC: i.MX8MN
#@DESCRIPTION: Machine configuration for Technexion EDM-G-IMX8MN
#@MAINTAINER: Andy Lin <andy.lin@technexion.com>

MACHINEOVERRIDES =. "mx8:mx8m:mx8mn:"

require conf/machine/include/imx-base.inc
require conf/machine/include/tune-cortexa53.inc
require conf/machine/tn-base.inc

# Kernel specifics
KERNEL_DEVICETREE ?= "freescale/imx8mn-edm-g-wb.dtb \
		      freescale/imx8mn-edm-g-wb-rpmsg.dtb \
		      freescale/overlays/imx8mn-edm-g-wb-tevi-ov5640.dtbo \
		      freescale/overlays/imx8mn-edm-g-wb-sn65dsi84-vl10112880.dtbo \
		      freescale/overlays/imx8mn-edm-g-wb-sn65dsi84-vl15613676.dtbo \
		      freescale/overlays/imx8mn-edm-g-wb-sn65dsi84-vl215192108.dtbo \
"

EXTRA_OEMAKE_append_pn-linux-tn-imx = " DTC_FLAGS='-@ -H epapr'"

# U-boot specifics
UBOOT_CONFIG = "sd"
UBOOT_CONFIG[sd] = "edm-g-imx8mn_defconfig,sdcard"
UBOOT_CONFIG[mfgtool] = "edm-g-imx8mn_defconfig"
UBOOT_DTB_NAME = "imx8mn-edm-g.dtb"

IMX_BOOT_SEEK_mx8mn = "32"
SERIAL_CONSOLES = "115200;ttymxc1"
SERIAL_BLUETOOTH = "3000000;ttymxc2"
BOOT_SPACE = "65536"

# Set DDR FIRMWARE
DDR_FIRMWARE_NAME = "lpddr4_pmu_train_1d_imem.bin lpddr4_pmu_train_1d_dmem.bin lpddr4_pmu_train_2d_imem.bin lpddr4_pmu_train_2d_dmem.bin"

#WKS_FILE_DEPENDS_append = " imx-m4-demos-tn"
#M4_MACHINE = "edm-g-imx8mn"
#IMAGE_BOOT_FILES += "hello_world.bin rpmsg_lite_pingpong_rtos_linux_remote.bin rpmsg_lite_str_echo_rtos_imxcm7.bin"

# WIC Image
WKS_FILE_virtualization = "tn-imx8-imxboot-rootfs-container.wks.in"
WIC_FSTAB_BLKDEV = "mmcblk2"
WIC_CREATE_EXTRA_ARGS_remove_virtualization = "--no-fstab-update"
WIC_PARTITION_TABLE_TYPE ?= "msdos"
IMAGE_FSTYPES_append_virtualization = " wic wic.xz wic.md5sum"
IMAGE_FSTYPES_remove_virtualization = " sdcard sdcard.bz2 sdcard.xz sdcard.md5sum"

IMAGE_BOOTLOADER = "imx-boot"
LOADADDR = ""
UBOOT_SUFFIX = "bin"
UBOOT_MAKE_TARGET = ""

# virtualization - docker containers
DOCKERDISKDEPENDS = "${@bb.utils.contains('DISTRO_FEATURES', 'virtualization', 'docker-disk:do_deploy', '', d)}"
do_image_wic[depends] += "${DOCKERDISKDEPENDS}"
TN_DOCKER_PARTITION_IMAGE = "docker-data-partition.img"
TN_DOCKER_PARTITION_MOUNT = "/var/lib/docker"
TN_DOCKER_PARTITION_SIZE = "4096"

# UBOOT entry address for fitImages
UBOOT_ENTRYPOINT_rescue = "0x40480000"
#UBOOT_RD_ENTRYPOINT_rescue = "0x43800000"
#UBOOT_RD_LOADADDRESS_rescue = "0x43800000"
UBOOT_DTB_LOADADDRESS_rescue = "0x40430000"
UBOOT_DTBO_LOADADDRESS_rescue = "0x40420000"
UBOOT_FIT_LOADADDRESS_rescue = "0x45800000"
UBOOT_FIT_PREFIX_rescue = "freescale_"
```

## conf/machine/edm-g-imx8mp.conf
```bitbake
#@TYPE: Machine
#@NAME: EDM-G-IMX8MP
#@SOC: i.MX8MM
#@DESCRIPTION: Machine configuration for TechNexion EDM-G-IMX8MP
#@MAINTAINER: Richard Hu <richard.hu@technexion.com>

MACHINEOVERRIDES =. "imx-boot-container:mx8mp:"

require conf/machine/include/imx-base.inc
require conf/machine/include/arm/armv8a/tune-cortexa53.inc
require conf/machine/tn-base.inc

# Kernel specifics
KERNEL_DEVICETREE = " \
                      freescale/imx8mp-edm-g-wb.dtb \
                      freescale/imx8mp-edm-g-wb-rpmsg.dtb \
                      freescale/overlays/imx8mp-edm-g-wb-lvds-vl10112880.dtbo \
                      freescale/overlays/imx8mp-edm-g-wb-lvds-vl15613676.dtbo \
                      freescale/overlays/imx8mp-edm-g-wb-lvds-vl215192108.dtbo \
                      freescale/overlays/imx8mp-edm-g-wb-hdmi2mipi-tc358743-single-cam1.dtbo \
                      freescale/overlays/imx8mp-edm-g-wb-hdmi2mipi-tc358743-dual.dtbo \
                      freescale/overlays/imx8mp-edm-g-wb-tevi-ov5640.dtbo \
                      freescale/overlays/imx8mp-edm-g-wb-tevi-ap1302.dtbo \
                      freescale/overlays/imx8mp-edm-g-wb-tevs.dtbo \
                      freescale/overlays/imx8mp-edm-g-wb-vizionlink-tevi-ov5640-dual.dtbo \
                      freescale/overlays/imx8mp-edm-g-wb-vizionlink-tevi-ap1302.dtbo \
                      freescale/overlays/imx8mp-edm-g-wb-vls-overlay.dtbo \
                      freescale/imx8mp-edm-g-wizard.dtb \
                      freescale/imx8mp-edm-g-wizard-rpmsg.dtb \
                      freescale/overlays/imx8mp-edm-g-wizard-lvds-vl10112880.dtbo \
                      freescale/overlays/imx8mp-edm-g-wizard-lvds-vl15613676.dtbo \
                      freescale/overlays/imx8mp-edm-g-wizard-lvds-vl215192108.dtbo \
                      freescale/overlays/imx8mp-edm-g-wizard-hdmi2mipi-tc358743-single-cam1.dtbo \
                      freescale/overlays/imx8mp-edm-g-wizard-hdmi2mipi-tc358743-dual.dtbo \
                      freescale/overlays/imx8mp-edm-g-wizard-tevi-ov5640.dtbo \
                      freescale/overlays/imx8mp-edm-g-wizard-tevi-ap1302.dtbo \
                      freescale/overlays/imx8mp-edm-g-wizard-vizionlink-tevi-ov5640-dual.dtbo \
                      freescale/overlays/imx8mp-edm-g-wizard-vizionlink-tevi-ap1302.dtbo \
                      freescale/overlays/imx8mp-edm-g-wizard-mipi2hdmi-adv7535.dtbo \
                      freescale/overlays/imx8mp-edm-g-wizard-ili9881c.dtbo \
                      freescale/overlays/imx8mp-edm-g-wizard-g101uan02.dtbo \
                      freescale/overlays/imx8mp-edm-g-wizard-vizionpanel-vl10112880.dtbo \
                      freescale/overlays/imx8mp-edm-g-wizard-vizionpanel-vl15010276.dtbo \
                      freescale/overlays/imx8mp-edm-g-wizard-vizionpanel-vl15613676.dtbo \
                      freescale/overlays/imx8mp-edm-g-wizard-vizionpanel-vl215192108.dtbo \
"
EXTRA_OEMAKE:append:pn-linux-tn-imx = " DTC_FLAGS='-@ -H epapr'"

# U-boot specifics
UBOOT_CONFIG = "sd"
UBOOT_CONFIG[sd] = "edm-g-imx8mp_defconfig,sdcard"
UBOOT_CONFIG[mfgtool] = "edm-g-imx8mp_defconfig"
UBOOT_DTB_NAME = "imx8mp-edm-g.dtb"

ATF_PLATFORM = "imx8mp"
ATF_LOAD_ADDR = "0x970000"
# Extra firmware package name, that is required to build boot container for fslc bsp
IMX_EXTRA_FIRMWARE = "firmware-imx-8m"
IMX_BOOT_SOC_TARGET = "iMX8MP"
IMX_BOOT_SEEK:edm-g-imx8mp = "32"

# Set Serial console
SERIAL_CONSOLES = "115200;ttymxc1"
SERIAL_BLUETOOTH = "3000000;ttymxc0"

BOOT_SPACE = "65536"

# Set DDR FIRMWARE
DDR_FIRMWARE_VERSION = "202006"
DDR_FIRMWARE_NAME:mx8-nxp-bsp = " \
	lpddr4_pmu_train_1d_dmem_${DDR_FIRMWARE_VERSION}.bin \
	lpddr4_pmu_train_1d_imem_${DDR_FIRMWARE_VERSION}.bin \
	lpddr4_pmu_train_2d_dmem_${DDR_FIRMWARE_VERSION}.bin \
	lpddr4_pmu_train_2d_imem_${DDR_FIRMWARE_VERSION}.bin \
"
# WIC Image
M7_MACHINE = "edm-g-imx8mp-wb"
WKS_FILE_DEPENDS:append = " imx-m7-demos-tn"
IMAGE_BOOTFILES += "hello_world.bin \
"
WKS_FILE:virtualization = "tn-imx8-imxboot-rootfs-container.wks.in"
WIC_FSTAB_BLKDEV = "mmcblk2"
WIC_CREATE_EXTRA_ARGS:remove:virtualization = "--no-fstab-update"
WIC_PARTITION_TABLE_TYPE ?= "msdos"
IMAGE_FSTYPES:append:virtualization = " wic wic.xz wic.md5sum"
IMAGE_FSTYPES:remove:virtualization = " sdcard sdcard.bz2 sdcard.xz sdcard.md5sum"
IMAGE_BOOT_FILES += "\
    ${IMAGE_BOOTFILES} \
"

# virtualization - docker containers
#DOCKERDISKDEPENDS = "${@bb.utils.contains('DISTRO_FEATURES', 'virtualization', 'docker-disk:do_deploy', '', d)}"
#do_image_wic[depends] += "${DOCKERDISKDEPENDS}"
#TN_DOCKER_PARTITION_IMAGE = "docker-data-partition.img"
#TN_DOCKER_PARTITION_MOUNT = "/var/lib/docker"
#TN_DOCKER_PARTITION_SIZE = "4096"
```

## conf/machine/edm-imx6.conf
```bitbake
#@TYPE: Machine
#@NAME: EDM-IMX6
#@SOC: i.MX6Q/Dual/DualLite/Solo
#@DESCRIPTION: Machine configuration for EDM-IMX6 with QCA(Qualcomm)/BRCM(Broadcom) WLAN module
#@MAINTAINER: Po Cheng <po.cheng@technexion.com>

MACHINEOVERRIDES =. "mx6q:mx6dl:"
MACHINEOVERRIDES_EXTENDER:edm-imx6 = "uenv"

include conf/machine/include/imx-base.inc
include conf/machine/include/arm/armv7a/tune-cortexa9.inc
require conf/machine/tn-base.inc

# Kernel Device Trees
KERNEL_DEVICETREE = " \
    nxp/imx/imx6dl-edm1-fairy.dtb nxp/imx/imx6dl-edm1-fairy-qca.dtb \
    nxp/imx/imx6dl-edm1-gnome.dtb nxp/imx/imx6dl-edm1-gnome-qca.dtb \
    nxp/imx/imx6dl-edm1-tc0700.dtb nxp/imx/imx6dl-edm1-tc0700-qca.dtb \
    nxp/imx/imx6dl-edm1-tc1000.dtb nxp/imx/imx6dl-edm1-tc1000-qca.dtb \
    nxp/imx/imx6q-edm1-fairy.dtb nxp/imx/imx6q-edm1-fairy-qca.dtb \
    nxp/imx/imx6q-edm1-gnome.dtb nxp/imx/imx6q-edm1-gnome-qca.dtb \
    nxp/imx/imx6q-edm1-tc0700.dtb nxp/imx/imx6q-edm1-tc0700-qca.dtb \
    nxp/imx/imx6q-edm1-tc1000.dtb nxp/imx/imx6q-edm1-tc1000-qca.dtb \
    nxp/imx/imx6qp-edm1-fairy.dtb nxp/imx/imx6qp-edm1-fairy-qca.dtb \
    nxp/imx/imx6qp-edm1-gnome.dtb nxp/imx/imx6qp-edm1-gnome-qca.dtb \
    nxp/imx/imx6qp-edm1-tc0700.dtb nxp/imx/imx6qp-edm1-tc0700-qca.dtb \
    nxp/imx/imx6qp-edm1-tc1000.dtb nxp/imx/imx6qp-edm1-tc1000-qca.dtb \
"

# Bootloader Specifics
UBOOT_MACHINE = "edm-imx6_spl_defconfig"

# Peripherals
# Set Serial console
SERIAL_CONSOLE = "115200;ttymxc0"
SERIAL_BLUETOOTH = "3000000;ttymxc2"

# WIC Image
WIC_FSTAB_BLKDEV = "mmcblk2"
#WIC_CREATE_EXTRA_ARGS = "--no-fstab-update"
WIC_PARTITION_TABLE_TYPE ?= "msdos"

BOOT_SPACE:edm-imx6 = "16392"
UBOOT_ENTRYPOINT:edm-imx6 = "0x12000000"
UBOOT_RD_ENTRYPOINT:edm-imx6 = "0x18100000"
UBOOT_RD_LOADADDRESS:edm-imx6 = "0x18100000"
UBOOT_FDT_LOADADDRESS:rescue = "0x18000000"
UBOOT_FDTOV_LOADADDRESS:rescue = "0x17FE0000"
UBOOT_FIT_LOADADDRESS:rescue = "0x21100000"
UBOOT_FIT_PREFIX:rescue = ""
```

## conf/machine/edm-imx7.conf
```bitbake
#@TYPE: Machine
#@NAME: edm-imx7
#@SOC: i.MX7/Solo/Dual/UtraLowPower
#@DESCRIPTION: Machine configuration for EDM-IMX7 with QCA(Qualcomm)/BRCM(Broadcom) WLAN module
#@MAINTAINER: Po Cheng <po.cheng@technexion.com>

MACHINEOVERRIDES =. "mx7:mx7d:"
MACHINEOVERRIDES_EXTENDER_edm-imx7 = "uenv"

include conf/machine/include/imx-base.inc
include conf/machine/include/tune-cortexa7.inc
require conf/machine/tn-base.inc

# Kernel Device Trees
KERNEL_DEVICETREE = "imx7d-edm1-gnome-qca.dtb imx7d-edm1-gnome-qca-m4.dtb"

# Bootloader Specifics
UBOOT_MACHINE = "edm-imx7d_spl_defconfig"

#M4_MACHINE = "pico-imx7d-pi"
#IMAGE_BOOTFILES_DEPENDS += "imx-m4-demos-tn:do_deploy"
#IMAGE_BOOTFILES += "hello_world.bin rpmsg_lite_pingpong_rtos_linux_remote.bin rpmsg_lite_str_echo_rtos_imxcm4.bin"

# override extender for graphics libs
MACHINEOVERRIDES_EXTENDER_mx7d = "imxpxp:imxepdc"
# mx7 GPU libraries
PREFERRED_PROVIDER_virtual/egl_mx7d = "mesa"
PREFERRED_PROVIDER_virtual/libgles1_mx7d = "mesa"
PREFERRED_PROVIDER_virtual/libgles2_mx7d = "mesa"
PREFERRED_PROVIDER_virtual/libgl_mx7d = "mesa"
PREFERRED_PROVIDER_virtual/libg2d_mx7d = ""
# MESA DRI library
XSERVER += "mesa-driver-swrast"

# Peripherals
# Set Serial console
SERIAL_CONSOLE = "115200;ttymxc2"
SERIAL_BLUETOOTH = "3000000;ttymxc6"

# WIC Image
WIC_FSTAB_BLKDEV = "mmcblk2"
#WIC_CREATE_EXTRA_ARGS = "--no-fstab-update"
WIC_PARTITION_TABLE_TYPE ?= "msdos"
#IMAGE_FSTYPES_append = " wic"
#IMAGE_BOOT_FILES = "\
#    ${KERNEL_IMAGETYPE} \
#    imx7d-pico*.dtb \
#    ${IMAGE_BOOTFILES} \
#    u-boot-${MACHINE}.${UBOOT_SUFFIX};u-boot.img \
#"
#do_image_wic[depends] += "imx-m4-demos-tn:do_deploy"

# UBOOT entry address for fitImages
UBOOT_ENTRYPOINT_edm-imx7 = "0x80800000"
UBOOT_RD_ENTRYPOINT_edm-imx7 = "0x83800000"
UBOOT_RD_LOADADDRESS_edm-imx7 = "0x83800000"
UBOOT_FDT_LOADADDRESS_rescue = "0x83000000"
UBOOT_FDTOV_LOADADDRESS_rescue = "0x82FE00000"
```

## conf/machine/edm-imx8mq.conf
```bitbake
#@TYPE: Machine
#@NAME: EDM-IMX8M
#@SOC: i.MX8MQ
#@DESCRIPTION: Machine configuration for EDM-IMX8MQ
#@MAINTAINER: Richard Hu <richard.hu@technexion.com>

MACHINEOVERRIDES =. "mx8:mx8m:mx8mq:"

require conf/machine/include/imx-base.inc
require conf/machine/include/tune-cortexa53.inc
require conf/machine/tn-base.inc

# Kernel Device Trees
KERNEL_DEVICETREE = "freescale/imx8mq-edm-wizard.dtb \
                     freescale/overlays/imx8mq-edm-wizard-ili9881c.dtbo \
                     freescale/overlays/imx8mq-edm-wizard-g080uan01.dtbo \
                     freescale/overlays/imx8mq-edm-wizard-g101uan02.dtbo \
                     freescale/overlays/imx8mq-edm-wizard-mipi2hdmi-adv7535.dtbo \
"
# Setup the additional devicetree file
#KERNEL_DEVICETREE_append_voicehat = " freescale/imx8mq-edm-wizard-voicehat.dtb"

M4_MACHINE = "edm-imx8mq-wizard"
IMAGE_BOOTFILES_DEPENDS += "imx-m4-demos-tn:do_deploy"
IMAGE_BOOTFILES += "hello_world.bin rpmsg_lite_pingpong_rtos_linux_remote.bin rpmsg_lite_str_echo_rtos_imxcm4.bin"

# Bootloader Specifics
UBOOT_CONFIG[sd] = "edm-imx8mq_defconfig,sdcard"
UBOOT_CONFIG[mfgtool] = "edm-imx8mq_defconfig"

# Set u-boot DTB
UBOOT_DTB_NAME = "imx8mq-edm-wizard.dtb"

# Peripherals
# Set Serial console
SERIAL_CONSOLES = "115200;ttymxc0"
SERIAL_BLUETOOTH = "3000000;ttymxc1"

# WIC Image
WKS_FILE_virtualization = "tn-imx8-imxboot-rootfs-container.wks.in"
WKS_FILE_edm-imx8mq = "imx-imx-boot-bootpart.wks.in"
WIC_FSTAB_BLKDEV = "mmcblk0"
WIC_CREATE_EXTRA_ARGS_remove_virtualization = "--no-fstab-update"
WIC_PARTITION_TABLE_TYPE ?= "msdos"
IMAGE_FSTYPES_append_virtualization = " wic wic.xz wic.md5sum"
IMAGE_FSTYPES_remove_virtualization = " sdcard sdcard.bz2 sdcard.xz sdcard.md5sum"
IMAGE_BOOT_FILES += "\
    ${IMAGE_BOOTFILES} \
"

# virtualization - docker containers
DOCKERDISKDEPENDS = "${@bb.utils.contains('DISTRO_FEATURES', 'virtualization', 'docker-disk:do_deploy', '', d)}"
do_image_wic[depends] += "imx-m4-demos-tn:do_deploy ${DOCKERDISKDEPENDS}"
TN_DOCKER_PARTITION_IMAGE = "docker-data-partition.img"
TN_DOCKER_PARTITION_MOUNT = "/var/lib/docker"
TN_DOCKER_PARTITION_SIZE = "2048"

# technexion rescue-loader - UBOOT entry address for fitImages
UBOOT_ENTRYPOINT_edm-imx8mq = "0x40480000"
#UBOOT_RD_ENTRYPOINT_edm-imx8mq = "0x43800000"
#UBOOT_RD_LOADADDRESS_edm-imx8mq = "0x43800000"
```

## conf/machine/edm-imx91.conf
```bitbake
#@TYPE: Machine
#@NAME: TechNexion EDM-IMX91
#@SOC: i.MX91
#@DESCRIPTION: Machine configuration for TechNexion EDM-IMX91
#@MAINTAINER: Joe Zhang <joe.zhang@technexion.com>

MACHINEOVERRIDES =. "mx91:"

require conf/machine/include/imx91-evk.inc
require conf/machine/tn-base.inc

# Kernel specifics
KERNEL_DEVICETREE = " \
		freescale/imx91-edm-wb.dtb \
		freescale/overlays/imx91-edm-wb-vxt-vl050-070-8048nt.dtbo \
		freescale/overlays/imx91-edm-wb-vxt-vl0808060nt.dtbo \
"
EXTRA_OEMAKE:append:pn-linux-tn-imx = " DTC_FLAGS='-@ -H epapr'"

# U-boot specifics
UBOOT_CONFIG = "sd"
UBOOT_CONFIG[sd] = "edm-imx91_defconfig,sdcard"
UBOOT_CONFIG[mfgtool] = "edm-imx91_defconfig"
UBOOT_DTB_NAME = "imx91-edm.dtb"

# Set ATF platform name
ATF_PLATFORM = "imx91"
IMXBOOT_TARGETS = "flash_singleboot"
IMX_BOOT_SOC_TARGET = "iMX91"
IMX_BOOT_SEEK:edm-imx91 = "32"

# Set Serial console
SERIAL_CONSOLES = "115200;ttyLP0"
SERIAL_BLUETOOTH = "3000000;ttyLP4"

DDR_FIRMWARE_NAME = " \
    lpddr4_dmem_1d_v202201.bin \
    lpddr4_dmem_2d_v202201.bin \
    lpddr4_imem_1d_v202201.bin \
    lpddr4_imem_2d_v202201.bin \
"
IMX_DEFAULT_BOOTLOADER:use-nxp-bsp = "u-boot-imx"
IMX_DEFAULT_BOOTLOADER:use-mainline-bsp = "u-boot-fslc"

# WIC Image
WIC_FSTAB_BLKDEV = "mmcblk0"
WIC_PARTITION_TABLE_TYPE ?= "msdos"
```
