## conf/bblayers.conf.sample
```bitbake
# POKY_BBLAYERS_CONF_VERSION is increased each time build/conf/bblayers.conf
# changes incompatibly
POKY_BBLAYERS_CONF_VERSION = "2"

BBPATH = "${TOPDIR}"
BBFILES ?= ""

BBLAYERS ?= " \
  ##OEROOT##/meta \
  ##OEROOT##/meta-poky \
  \
  ##OEROOT##/../meta-openembedded/meta-oe \
  ##OEROOT##/../meta-openembedded/meta-multimedia \
  ##OEROOT##/../meta-openembedded/meta-python \
  \
  ##OEROOT##/../meta-freescale \
  ##OEROOT##/../meta-freescale-3rdparty \
  ##OEROOT##/../meta-freescale-distro \
  \
  ##OEROOT##/../meta-imx/meta-bsp \
  ##OEROOT##/../meta-imx/meta-sdk \
  ##OEROOT##/../meta-imx/meta-ml \
  \
  ##OEROOT##/../meta-openembedded/meta-gnome \
  ##OEROOT##/../meta-openembedded/meta-networking \
  ##OEROOT##/../meta-openembedded/meta-filesystems \
  \
  ##OEROOT##/../meta-python2 \
  ##OEROOT##/../meta-browser \
  ##OEROOT##/../meta-rust \
  ##OEROOT##/../meta-qt6 \
  ##OEROOT##/../meta-qt4 \
  \
  ##OEROOT##/../meta-tn-imx-bsp \
  \
  ##OEROOT##/../meta-nxp-nfc \
  ##OEROOT##/../meta-virtualization \
"
```

## conf/layer.conf
```bitbake
# We have a conf and classes directory, add to BBPATH
BBPATH .= ":${LAYERDIR}"

# We have recipes-* directories, add to BBFILES
BBFILES += "${LAYERDIR}/recipes-*/*/*.bb \
            ${LAYERDIR}/recipes-*/*/*.bbappend"

BBFILE_COLLECTIONS += "meta-tn-imx-bsp"
BBFILE_PATTERN_meta-tn-imx-bsp = "^${LAYERDIR}/"
BBFILE_PRIORITY_meta-tn-imx-bsp = "9"

LAYERDEPENDS_meta-tn-imx-bsp = "core"
LAYERSERIES_COMPAT_meta-tn-imx-bsp = "scarthgap"

BBFILES_DYNAMIC += " \
    swupdate-imx:${LAYERDIR}/dynamic-layers/swupdate-imx/*/*/*/*.bbappend \
    \
    chromium-browser-layer:${LAYERDIR}/dynamic-layers/chromium-browser-layer/*/*/*.bb \
    chromium-browser-layer:${LAYERDIR}/dynamic-layers/chromium-browser-layer/*/*/*.bbappend \
    \
    nxp-nfc:${LAYERDIR}/dynamic-layers/nxp-nfc/*/*/*.bb \
    nxp-nfc:${LAYERDIR}/dynamic-layers/nxp-nfc/*/*/*.bbappend \
    \
    qt6-layer:${LAYERDIR}/dynamic-layers/qt6-layer/*/*/*.bb \
    qt6-layer:${LAYERDIR}/dynamic-layers/qt6-layer/*/*/*.bbappend \
    \
    virtualization-layer:${LAYERDIR}/dynamic-layers/virtualization-layer/*/*/*.bb \
    virtualization-layer:${LAYERDIR}/dynamic-layers/virtualization-layer/*/*/*.bbappend \
"
```

## conf/machine/axon-imx6.conf
```bitbake
#@TYPE: Machine
#@NAME: AXON-IMX6
#@SOC: i.MX6Quad/DualLite/Solo
#@DESCRIPTION: Machine configuration for AXON-IMX6
#@MAINTAINER: Po Cheng <po.cheng@technexion.com>

MACHINEOVERRIDES =. "mx6:mx6dl:mx6q:"
MACHINEOVERRIDES_EXTENDER_axon-imx6 = "uenv"

include conf/machine/include/imx-base.inc
include conf/machine/include/tune-cortexa9.inc
require conf/machine/tn-base.inc

# Kernel specifics
KERNEL_DEVICETREE ?= " \
	imx6dl-axon-pi.dtb \
	imx6q-axon-pi.dtb \
	imx6dl-axon-loopbacktest.dtb \
	imx6q-axon-loopbacktest.dtb \
	imx6dl-axon-wizard.dtb \
	imx6q-axon-wizard.dtb \
"

# Bootloader Specifics
UBOOT_MACHINE = "axon-imx6_defconfig"

# Extra Stuff
BOOT_SPACE = "32768"

MACHINE_EXTRA_RRECOMMENDS += " \
  afloader axonfabric-firmware \
"

# Peripherals - Set Serial console
SERIAL_CONSOLE = "115200 ttymxc0"
SERIAL_BLUETOOTH = "3000000;ttymxc4"

# WIC Image
WIC_FSTAB_BLKDEV = "mmcblk2"
#WIC_CREATE_EXTRA_ARGS = "--no-fstab-update"
WIC_PARTITION_TABLE_TYPE ?= "msdos"
#IMAGE_FSTYPES_append = " wic"
#IMAGE_BOOT_FILES = "\
#    ${KERNEL_IMAGETYPE} \
#    imx6*-pico*.dtb \
#    ${IMAGE_BOOTFILES} \
#    u-boot-${MACHINE}.${UBOOT_SUFFIX};u-boot.img \
#"

# UBOOT entry address for fitImages
UBOOT_ENTRYPOINT_axon-imx6 = "0x12000000"
UBOOT_RD_ENTRYPOINT_axon-imx6 = "0x18100000"
UBOOT_RD_LOADADDRESS_axon-imx6 = "0x18100000"
UBOOT_FDT_LOADADDRESS_rescue = "0x1800000"
UBOOT_FDTOV_LOADADDRESS_rescue = "0x17FE0000"
```

## conf/machine/axon-imx8mm.conf
```bitbake
#@TYPE: Machine
#@NAME: AXON-IMX8M
#@SOC: i.MX8MM
#@DESCRIPTION: Machine configuration for TechNexion AXON-IMX8MM
#@MAINTAINER: Richard Hu <richard.hu@technexion.com>

MACHINEOVERRIDES =. "mx8:mx8m:mx8mm:"

require conf/machine/include/imx-base.inc
require conf/machine/include/tune-cortexa53.inc
require conf/machine/tn-base.inc

# Kernel specifics
KERNEL_DEVICETREE ?= " \
	freescale/imx8mm-axon-loopbacktest.dtb \
	freescale/imx8mm-axon-pi.dtb \
	freescale/overlays/imx8mm-axon-pi-voicehat.dtbo \
	freescale/imx8mm-axon-wizard.dtb \
	freescale/overlays/imx8mm-axon-wizard-voicehat.dtbo \
	freescale/overlays/imx8mm-axon-wizard-ili9881c.dtbo \
	freescale/overlays/imx8mm-axon-wizard-g101uan02.dtbo \
	freescale/overlays/imx8mm-axon-wizard-mipi2hdmi-adv7535.dtbo \
	freescale/overlays/imx8mm-axon-wizard-sn65dsi84-vl10112880.dtbo \
	freescale/overlays/imx8mm-axon-wizard-sn65dsi84-vl15613676.dtbo \
	freescale/overlays/imx8mm-axon-wizard-sn65dsi84-vl215192108.dtbo"

EXTRA_OEMAKE_append_pn-linux-tn-imx = " DTC_FLAGS='-@ -H epapr'"
# U-boot specifics
UBOOT_CONFIG[sd] = "axon-imx8mm_defconfig,sdcard"
UBOOT_CONFIG[mfgtool] = "axon-imx8mm_defconfig"
UBOOT_DTB_NAME = "imx8mm-axon-pi.dtb"

# Set Serial console
SERIAL_CONSOLE = "115200;ttymxc0"
SERIAL_BLUETOOTH = "3000000;ttymxc3"

BOOT_SPACE = "65536"

# WIC Image
WKS_FILE_virtualization = "tn-imx8-imxboot-rootfs-container.wks.in"
WKS_FILE_axon-imx8mm = "imx-imx-boot-bootpart.wks.in"
WIC_FSTAB_BLKDEV = "mmcblk2"
WIC_CREATE_EXTRA_ARGS_remove_virtualization = "--no-fstab-update"
WIC_PARTITION_TABLE_TYPE ?= "msdos"
IMAGE_FSTYPES_append_virtualization = " wic wic.xz wic.md5sum"
IMAGE_FSTYPES_remove_virtualization = " sdcard sdcard.bz2 sdcard.xz sdcard.md5sum"
#IMAGE_BOOT_FILES += " \
#    ${IMAGE_BOOTFILES} \
#"

# virtualization - docker containers
DOCKERDISKDEPENDS = "${@bb.utils.contains('DISTRO_FEATURES', 'virtualization', 'docker-disk:do_deploy', '', d)}"
do_image_wic[depends] += "${DOCKERDISKDEPENDS}"
TN_DOCKER_PARTITION_IMAGE = "docker-data-partition.img"
TN_DOCKER_PARTITION_MOUNT = "/var/lib/docker"
TN_DOCKER_PARTITION_SIZE = "4096"

# technexion rescue-loader - UBOOT entry address for fitImages
UBOOT_ENTRYPOINT_axon-imx8mm = "0x40480000"
#UBOOT_RD_ENTRYPOINT_axon-imx8mm = "0x43800000"
#UBOOT_RD_LOADADDRESS_axon-imx8mm = "0x43800000"

# Other stuff
MACHINE_EXTRA_RRECOMMENDS += " \
  afloader axonfabric-firmware \
"
```

## conf/machine/axon-imx8mp.conf
```bitbake
#@TYPE: Machine
#@NAME: AXON-IMX8MP
#@SOC: i.MX8MM
#@DESCRIPTION: Machine configuration for TechNexion AXON-IMX8MP
#@MAINTAINER: Richard Hu <richard.hu@technexion.com>

MACHINEOVERRIDES =. "imx-boot-container:mx8mp:"

require conf/machine/include/imx-base.inc
require conf/machine/include/arm/armv8a/tune-cortexa53.inc
require conf/machine/tn-base.inc

# Kernel specifics
KERNEL_DEVICETREE = " \
              freescale/imx8mp-axon-wizard.dtb \
		      freescale/overlays/imx8mp-axon-wizard-lvds-vl10112880.dtbo \
		      freescale/overlays/imx8mp-axon-wizard-lvds-vl15613676.dtbo \
		      freescale/overlays/imx8mp-axon-wizard-lvds-vl215192108.dtbo \
		      freescale/overlays/imx8mp-axon-wizard-ili9881c.dtbo \
		      freescale/overlays/imx8mp-axon-wizard-g101uan02.dtbo \
		      freescale/overlays/imx8mp-axon-wizard-g080uan01.dtbo \
		      freescale/overlays/imx8mp-axon-wizard-mipi2hdmi-adv7535.dtbo \
		      freescale/overlays/imx8mp-axon-wizard-tevi-ov5640.dtbo \
		      freescale/overlays/imx8mp-axon-wizard-tevi-ap1302.dtbo \
		      freescale/overlays/imx8mp-axon-wizard-vizionlink-tevi-ov5640-csi0.dtbo \
		      freescale/overlays/imx8mp-axon-wizard-vizionlink-tevi-ov5640-csi1.dtbo \
		      freescale/overlays/imx8mp-axon-wizard-vizionlink-tevi-ov5640-dual.dtbo \
		      freescale/overlays/imx8mp-axon-wizard-vizionlink-tevi-ap1302.dtbo \
		      freescale/overlays/imx8mp-axon-wizard-hdmi2mipi-tc358743-single-cam1.dtbo \
"

#KERNEL_DEVICETREE:append:voicehat = " freescale/imx8mp-axon-wizard-voicehat.dtb \
#"

EXTRA_OEMAKE:append:pn-linux-tn-imx = " DTC_FLAGS='-@ -H epapr'"

# U-boot specifics
UBOOT_CONFIG = "sd"
UBOOT_CONFIG[sd] = "axon-imx8mp_defconfig,sdcard"
UBOOT_CONFIG[mfgtool] = "axon-imx8mp_defconfig"
UBOOT_DTB_NAME = "imx8mp-axon.dtb"

ATF_PLATFORM = "imx8mp"
ATF_LOAD_ADDR = "0x970000"
# Extra firmware package name, that is required to build boot container for fslc bsp
IMX_EXTRA_FIRMWARE = "firmware-imx-8m"
IMX_BOOT_SOC_TARGET = "iMX8MP"
IMX_BOOT_SEEK:axon-imx8mp = "32"

# Set Serial console
SERIAL_CONSOLES = "115200;ttymxc1"
SERIAL_BLUETOOTH = "3000000;ttymxc0"

BOOT_SPACE = "65536"

# Set DDR FIRMWARE
DDR_FIRMWARE_VERSION = "202006"
DDR_FIRMWARE_NAME:mx8-nxp-bsp = " \
	lpddr4_pmu_train_1d_dmem_${DDR_FIRMWARE_VERSION}.bin \
	lpddr4_pmu_train_1d_imem_${DDR_FIRMWARE_VERSION}.bin \
	lpddr4_pmu_train_2d_dmem_${DDR_FIRMWARE_VERSION}.bin \
	lpddr4_pmu_train_2d_imem_${DDR_FIRMWARE_VERSION}.bin \
"
# WIC Image
#M7_MACHINE = "axon-imx8mp"
#WKS_FILE_DEPENDS:append = " imx-m7-demos-tn"
#IMAGE_BOOTFILES += "hello_world.bin \
#                    rpmsg_lite_pingpong_rtos_linux_remote.bin \
#                    rpmsg_lite_str_echo_rtos.bin \
#"

WKS_FILE:virtualization = "tn-imx8-imxboot-rootfs-container.wks.in"
WIC_FSTAB_BLKDEV = "mmcblk2"
WIC_CREATE_EXTRA_ARGS:remove:virtualization = "--no-fstab-update"
WIC_PARTITION_TABLE_TYPE ?= "msdos"
IMAGE_FSTYPES:append:virtualization = " wic.xz wic.md5sum"
IMAGE_FSTYPES:remove:virtualization = " sdcard sdcard.bz2 sdcard.xz sdcard.md5sum"
#IMAGE_BOOT_FILES += "\
#    ${IMAGE_BOOTFILES} \
#"

# virtualization - docker containers
#DOCKERDISKDEPENDS = "${@bb.utils.contains('DISTRO_FEATURES', 'virtualization', 'docker-disk:do_deploy', '', d)}"
#do_image_wic[depends] += "${DOCKERDISKDEPENDS}"
#TN_DOCKER_PARTITION_IMAGE = "docker-data-partition.img"
#TN_DOCKER_PARTITION_MOUNT = "/var/lib/docker"
#TN_DOCKER_PARTITION_SIZE = "4096"
```

## conf/machine/axon-imx93.conf
```bitbake
#@TYPE: Machine
#@NAME: TechNexion AXON-IMX93
#@SOC: NXP i.MX93
#@DESCRIPTION: Machine configuration for TechNexion i.MX 93 AXON board
#@MAINTAINER: Joe Zhange <joe.zhang@technexion.com>

MACHINEOVERRIDES =. "mx93:"

require conf/machine/include/imx-base.inc
require conf/machine/include/arm/armv8-2a/tune-cortexa55.inc
require conf/machine/tn-base.inc

# Kernel specifics
KERNEL_DEVICETREE = " \
		freescale/imx93-axon-wb.dtb \
		freescale/overlays/imx93-axon-wb-lvds-vl10112880.dtbo \
		freescale/overlays/imx93-axon-wb-lvds-vl15613676.dtbo \
		freescale/overlays/imx93-axon-wb-vxt-vl050-070-8048nt.dtbo \
		freescale/overlays/imx93-axon-wb-vxt-vl0808060nt.dtbo \
		freescale/overlays/imx93-axon-wb-tevs.dtbo \
"
EXTRA_OEMAKE:append:pn-linux-tn-imx = " DTC_FLAGS='-@ -H epapr'"

# U-boot specifics
UBOOT_CONFIG = "sd"
UBOOT_CONFIG[sd] = "axon-imx93_defconfig,sdcard"
UBOOT_CONFIG[mfgtool] = "axon-imx93_defconfig"
UBOOT_DTB_NAME = "imx93-axon.dtb"

# Set ATF platform name
ATF_PLATFORM = "imx93"
IMXBOOT_TARGETS = "flash_singleboot"
IMX_BOOT_SOC_TARGET = "iMX9"
IMX_BOOT_SEEK:axon-imx93 = "32"

# Set Serial console
SERIAL_CONSOLES = "115200;ttyLP0"
SERIAL_BLUETOOTH = "3000000;ttyLP4"

DDR_FIRMWARE_NAME = " \
    lpddr4_dmem_1d_v202201.bin \
    lpddr4_dmem_2d_v202201.bin \
    lpddr4_imem_1d_v202201.bin \
    lpddr4_imem_2d_v202201.bin \
"
IMX_DEFAULT_BOOTLOADER:use-nxp-bsp = "u-boot-imx"
IMX_DEFAULT_BOOTLOADER:use-mainline-bsp = "u-boot-fslc"

# WIC Image
WIC_FSTAB_BLKDEV = "mmcblk0"
WIC_PARTITION_TABLE_TYPE ?= "msdos"
```

## conf/machine/edm-e-imx93.conf
```bitbake
#@TYPE: Machine
#@NAME: TechNexion EDM-E-IMX93
#@SOC: NXP i.MX93
#@DESCRIPTION: Machine configuration for TechNexion i.MX 93 EDM-E board
#@MAINTAINER: Alex Fang <alex.fang@technexion.com>

MACHINEOVERRIDES =. "mx93:"

require conf/machine/include/imx-base.inc
require conf/machine/include/arm/armv8-2a/tune-cortexa55.inc
require conf/machine/tn-base.inc

# Kernel specifics
KERNEL_DEVICETREE = " \
		freescale/imx93-edm-e-wb.dtb \
		freescale/overlays/imx93-edm-e-wb-lvds-vl10112880.dtbo \
		freescale/overlays/imx93-edm-e-wb-lvds-vl15613676.dtbo \
		freescale/overlays/imx93-edm-e-wb-vxt-vl0508048nt.dtbo \
		freescale/overlays/imx93-edm-e-wb-vxt-vl0708048nt.dtbo \
		freescale/overlays/imx93-edm-e-wb-vxt-vl0808060nt.dtbo \
		freescale/overlays/imx93-edm-e-wb-tevs.dtbo \
"
EXTRA_OEMAKE:append:pn-linux-tn-imx = " DTC_FLAGS='-@ -H epapr'"

# U-boot specifics
UBOOT_CONFIG = "sd"
UBOOT_CONFIG[sd] = "edm-e-imx93_defconfig,sdcard"
UBOOT_CONFIG[mfgtool] = "edm-e-imx93_defconfig"
UBOOT_DTB_NAME = "imx93-edm-e.dtb"

# Set ATF platform name
ATF_PLATFORM = "imx93"
IMXBOOT_TARGETS = "flash_singleboot"
IMX_BOOT_SOC_TARGET = "iMX9"
IMX_BOOT_SEEK:edm-e-imx93 = "32"

# Set Serial console
SERIAL_CONSOLES = "115200;ttyLP0"
SERIAL_BLUETOOTH = "3000000;ttyLP4"

DDR_FIRMWARE_NAME = " \
    lpddr4_dmem_1d_v202201.bin \
    lpddr4_dmem_2d_v202201.bin \
    lpddr4_imem_1d_v202201.bin \
    lpddr4_imem_2d_v202201.bin \
"
IMX_DEFAULT_BOOTLOADER:use-nxp-bsp = "u-boot-imx"
IMX_DEFAULT_BOOTLOADER:use-mainline-bsp = "u-boot-fslc"

# WIC Image
WIC_FSTAB_BLKDEV = "mmcblk0"
WIC_PARTITION_TABLE_TYPE ?= "msdos"
```

## conf/machine/edm-g-imx8mm.conf
```bitbake
#@TYPE: Machine
#@NAME: EDM-G-IMX8MM
#@SOC: i.MX8MM
#@DESCRIPTION: Machine configuration for TechNexion EDM-G-IMX8MM
#@MAINTAINER: Richard Hu <richard.hu@technexion.com>

MACHINEOVERRIDES =. "mx8:mx8m:mx8mm:"

require conf/machine/include/imx-base.inc
require conf/machine/include/tune-cortexa53.inc
require conf/machine/tn-base.inc

# Kernel specifics
KERNEL_DEVICETREE ?= " \
	freescale/imx8mm-edm-g-wb.dtb \
	freescale/overlays/imx8mm-edm-g-wb-hdmi2mipi-tc358743.dtbo \
	freescale/overlays/imx8mm-edm-g-wb-tevi-ov5640.dtbo \
	freescale/overlays/imx8mm-edm-g-wb-sn65dsi84-vl10112880.dtbo \
	freescale/overlays/imx8mm-edm-g-wb-sn65dsi84-vl15613676.dtbo \
	freescale/overlays/imx8mm-edm-g-wb-sn65dsi84-vl215192108.dtbo \
"
EXTRA_OEMAKE_append_pn-linux-tn-imx = " DTC_FLAGS='-@ -H epapr'"

# U-boot specifics
UBOOT_CONFIG[sd] = "edm-g-imx8mm_defconfig,sdcard"
UBOOT_CONFIG[mfgtool] = "edm-g-imx8mm_defconfig"
UBOOT_DTB_NAME = "imx8mm-edm-g-wb.dtb"

# Set Serial console
SERIAL_CONSOLE = "115200;ttymxc1"
SERIAL_BLUETOOTH = "3000000;ttymxc2"

BOOT_SPACE = "65536"

# WIC Image
WKS_FILE_virtualization = "tn-imx8-imxboot-rootfs-container.wks.in"
WIC_FSTAB_BLKDEV = "mmcblk2"
WIC_CREATE_EXTRA_ARGS_remove_virtualization = "--no-fstab-update"
WIC_PARTITION_TABLE_TYPE ?= "msdos"
IMAGE_FSTYPES_append_virtualization = " wic wic.xz wic.md5sum"
IMAGE_FSTYPES_remove_virtualization = " sdcard sdcard.bz2 sdcard.xz sdcard.md5sum"
#IMAGE_BOOT_FILES += "\
#    ${IMAGE_BOOTFILES} \
#"

# virtualization - docker containers
DOCKERDISKDEPENDS = "${@bb.utils.contains('DISTRO_FEATURES', 'virtualization', 'docker-disk:do_deploy', '', d)}"
do_image_wic[depends] += "${DOCKERDISKDEPENDS}"
TN_DOCKER_PARTITION_IMAGE = "docker-data-partition.img"
TN_DOCKER_PARTITION_MOUNT = "/var/lib/docker"
TN_DOCKER_PARTITION_SIZE = "4096"

# UBOOT entry address for fitImages
UBOOT_ENTRYPOINT_rescue = "0x40480000"
#UBOOT_RD_ENTRYPOINT_rescue = "0x43800000"
#UBOOT_RD_LOADADDRESS_rescue = "0x43800000"
UBOOT_DTB_LOADADDRESS_rescue = "0x40430000"
UBOOT_DTBO_LOADADDRESS_rescue = "0x40420000"
UBOOT_FIT_LOADADDRESS_rescue = "0x45800000"
UBOOT_FIT_PREFIX_rescue = "freescale_"
```
