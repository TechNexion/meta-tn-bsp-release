## conf/machine/flex-imx8mm.conf
```bitbake
#@TYPE: Machine
#@NAME: FLEX-IMX8MM
#@SOC: i.MX8MM
#@DESCRIPTION: Machine configuration for FLEX-IMX8MM
#@MAINTAINER: Ray Cheng <ray.cheng@technexion.com>

MACHINEOVERRIDES =. "mx8:mx8m:mx8mm:"

require conf/machine/include/imx-base.inc
require conf/machine/include/tune-cortexa53.inc
require conf/machine/tn-base.inc

# Kernel Device Trees
KERNEL_DEVICETREE = "freescale/imx8mm-flex-pi.dtb \
                     freescale/overlays/imx8mm-flex-pi-tevi-ov5640.dtbo \
                     freescale/overlays/imx8mm-flex-pi-ili9881c.dtbo \
                     freescale/overlays/imx8mm-flex-pi-clixwifi.dtbo \
                     freescale/imx8mm-flex-wizard.dtb \
                     freescale/overlays/imx8mm-flex-wizard-tevi-ov5640.dtbo \
                     freescale/overlays/imx8mm-flex-wizard-ili9881c.dtbo \
                     freescale/overlays/imx8mm-flex-wizard-g080uan01.dtbo \
                     freescale/overlays/imx8mm-flex-wizard-g101uan02.dtbo \
                     freescale/overlays/imx8mm-flex-wizard-mipi2hdmi-adv7535.dtbo \
                     freescale/overlays/imx8mm-flex-wizard-sn65dsi84-vl10112880.dtbo \
                     freescale/overlays/imx8mm-flex-wizard-sn65dsi84-vl15613676.dtbo \
                     freescale/overlays/imx8mm-flex-wizard-sn65dsi84-vl215192108.dtbo \
                     freescale/overlays/imx8mm-flex-wizard-clix1wifi.dtbo \
                     freescale/overlays/imx8mm-flex-wizard-clix1nfc.dtbo \
                     freescale/overlays/imx8mm-flex-wizard-clix2nfc.dtbo \
"
# Setup the additional devicetree file
KERNEL_DEVICETREE_append_voicehat = " freescale/overlays/imx8mm-flex-pi-voicehat.dtbo \
                                      freescale/overlays/imx8mm-flex-wizard-voicehat.dtbo \
"
EXTRA_OEMAKE_append_pn-linux-tn-imx = " DTC_FLAGS='-@ -H epapr'"

M4_MACHINE = "flex-imx8mm-pi"
IMAGE_BOOTFILES_DEPENDS += "imx-m4-demos-tn:do_deploy"
IMAGE_BOOTFILES += "hello_world.bin rpmsg_lite_pingpong_rtos_linux_remote.bin rpmsg_lite_str_echo_rtos_imxcm4.bin"

# Bootloader Specifics
UBOOT_CONFIG[sd] = "flex-imx8mm_defconfig,sdcard"
UBOOT_CONFIG[mfgtool] = "flex-imx8mm_defconfig"

# Set u-boot DTB
UBOOT_DTB_NAME = "imx8mm-flex-pi.dtb imx8mm-flex-wizard.dtb"

# Peripherals
# Set Serial console
SERIAL_CONSOLES = "115200;ttymxc1"
SERIAL_BLUETOOTH = "3000000;ttymxc0"

# WIC Image
WIC_FSTAB_BLKDEV = "mmcblk2"
#WIC_CREATE_EXTRA_ARGS = "--no-fstab-update"
WIC_PARTITION_TABLE_TYPE ?= "msdos"
#IMAGE_FSTYPES_append = " wic"
IMAGE_BOOT_FILES += "\
    ${IMAGE_BOOTFILES} \
"
do_image_wic[depends] += "imx-m4-demos-tn:do_deploy"

# technexion rescue-loader - UBOOT entry address for fitImages
UBOOT_ENTRYPOINT_rescue = "0x40480000"
#UBOOT_RD_ENTRYPOINT_rescue = "0x43800000"
#UBOOT_RD_LOADADDRESS_rescue = "0x43800000"
UBOOT_DTB_LOADADDRESS_rescue = "0x40430000"
UBOOT_DTBO_LOADADDRESS_rescue = "0x40420000"
UBOOT_FIT_LOADADDRESS_rescue = "0x45800000"
UBOOT_FIT_PREFIX_rescue = "freescale_"
```

## conf/machine/imx8mp-ddr4-evk-extra.conf
```bitbake
KERNEL_DEVICETREE:append = " \
	freescale/imx8mp-evk-vizionlink-tevi-ap1302.dtb \
	freescale/imx8mp-evk-tevi-ap1302.dtb \
"
OVERRIDES:append = ":tevi"
IMAGE_FSTYPES:append = " ext4 wic.md5sum wic.xz wic.bz2"

#------ For Ubuntu ------
APTGET_EXTRA_PACKAGES:append:ubuntu = " libglu1-mesa"

#------ For VizionSDK/VizionViewer ------
IMAGE_INSTALL:append:tn-vizionsdk = " tn-apt-list vizionsdk-dev vizionviewer"
APTGET_EXTRA_PACKAGES:append:tn-vizionsdk += " gnupg"

#------ For Ubuntu inspect V4L2 ------
APTGET_EXTRA_PACKAGES:append:ubuntu += " v4l-utils"
```

## conf/machine/imx8mp-lpddr4-evk-extra.conf
```bitbake
KERNEL_DEVICETREE:append = " \
	freescale/imx8mp-evk-tevs.dtb \
"
OVERRIDES:append = ":tn-camera"
IMAGE_FSTYPES:append = " ext4 wic.md5sum wic.xz wic.bz2"

#------ For Ubuntu ------
APTGET_EXTRA_PACKAGES:append:ubuntu = " libglu1-mesa"

#------ For VizionSDK/VizionViewer ------
LICENSE_FLAGS_ACCEPTED:append = "commercial_tn"
IMAGE_INSTALL:append = "tn-apt-list vizionsdk-dev vizionviewer"
APTGET_EXTRA_PACKAGES:append = "gnupg"

#------ For Ubuntu inspect V4L2 ------
APTGET_EXTRA_PACKAGES:append:ubuntu = "v4l-utils"
```

## conf/machine/pico-imx6.conf
```bitbake
#@TYPE: Machine
#@NAME: PICO-IMX6
#@SOC: i.MX6Q/Dual/DualLite/Solo
#@DESCRIPTION: Machine configuration for PICO-IMX6 with QCA(Qualcomm) WLAN module
#@MAINTAINER: Po Cheng <po.cheng@technexion.com>

MACHINEOVERRIDES =. "mx6:mx6dl:mx6q:"
MACHINEOVERRIDES_EXTENDER_pico-imx6 = "uenv"

include conf/machine/include/imx-base.inc
include conf/machine/include/tune-cortexa9.inc
require conf/machine/tn-base.inc

# Kernel Device Trees
KERNEL_DEVICETREE = "imx6dl-pico-pi-qca.dtb imx6q-pico-pi-qca.dtb \
                     imx6dl-pico-nymph-qca.dtb imx6q-pico-nymph-qca.dtb \
                     imx6dl-pico-dwarf-qca.dtb imx6q-pico-dwarf-qca.dtb \
                     imx6dl-pico-hobbit-qca.dtb imx6q-pico-hobbit-qca.dtb \
"

# Bootloader Specifics
UBOOT_MACHINE = "pico-imx6_spl_defconfig"

# Peripherals
# Set Serial console
SERIAL_CONSOLE = "115200;ttymxc0"
SERIAL_BLUETOOTH = "3000000;ttymxc1"

# WIC Image
WIC_FSTAB_BLKDEV = "mmcblk2"
#WIC_CREATE_EXTRA_ARGS = "--no-fstab-update"
WIC_PARTITION_TABLE_TYPE ?= "msdos"
#IMAGE_FSTYPES_append = " wic"
IMAGE_BOOT_FILES = "\
    ${KERNEL_IMAGETYPE} \
    ${KERNEL_DEVICETREE} \
    u-boot-${MACHINE}.${UBOOT_SUFFIX};u-boot-dtb.img \
"

# UBOOT entry address for fitImages
UBOOT_ENTRYPOINT_pico-imx6 = "0x12000000"
UBOOT_RD_ENTRYPOINT_pico-imx6 = "0x18100000"
UBOOT_RD_LOADADDRESS_pico-imx6 = "0x18100000"
UBOOT_FDT_LOADADDRESS_rescue = "0x18000000"
UBOOT_FDTOV_LOADADDRESS_rescue = "0x17FE0000"
UBOOT_FIT_LOADADDRESS_rescue = "0x21100000"
UBOOT_FIT_PREFIX_rescue = ""
```

## conf/machine/pico-imx6ul.conf
```bitbake
#@TYPE: Machine
#@NAME: PICO-IMX6UL
#@SOC: i.MX6UL/ULL
#@DESCRIPTION: Machine configuration for PICO-IMX6 with QCA(Qualcomm)/BRCM(Broadcom) WLAN module
#@MAINTAINER:	Andy Lin <andy.lin@technecion.com>

MACHINEOVERRIDES =. "mx6ull:"
MACHINEOVERRIDES_EXTENDER:pico-imx6ul = "uenv"

include conf/machine/include/imx-base.inc
include conf/machine/include/arm/armv7a/tune-cortexa7.inc
require conf/machine/tn-base.inc

# Kernel Device Trees
KERNEL_DEVICETREE = "imx6ul-pico-pi-qca.dtb imx6ull-pico-pi-qca.dtb \
                     imx6ul-pico-nymph-qca.dtb imx6ull-pico-nymph-qca.dtb \
                     imx6ul-pico-dwarf-qca.dtb imx6ull-pico-dwarf-qca.dtb \
                     imx6ul-pico-hobbit-qca.dtb imx6ull-pico-hobbit-qca.dtb \
                     imx6ul-pico-pi.dtb imx6ull-pico-pi.dtb \
                     imx6ul-pico-nymph.dtb imx6ull-pico-nymph.dtb \
                     imx6ul-pico-dwarf.dtb imx6ull-pico-dwarf.dtb \
                     imx6ul-pico-hobbit.dtb imx6ull-pico-hobbit.dtb \
"

# Bootloader Specifics
UBOOT_MACHINE = "pico-imx6ul_spl_defconfig"

# Peripherals
# Set Serial console
SERIAL_CONSOLE = "115200;ttymxc5"
SERIAL_BLUETOOTH = "3000000;ttymxc4"

# WIC Image
WIC_FSTAB_BLKDEV = "mmcblk2"
#WIC_CREATE_EXTRA_ARGS = "--no-fstab-update"
WIC_PARTITION_TABLE_TYPE ?= "msdos"
#IMAGE_FSTYPES:append = " wic"
IMAGE_BOOT_FILES = "\
    ${KERNEL_IMAGETYPE} \
    ${KERNEL_DEVICETREE} \
    u-boot-${MACHINE}.${UBOOT_SUFFIX};u-boot-dtb.img \
"

# UBOOT entry address for fitImages
UBOOT_ENTRYPOINT:pico-imx6ul = "0x80800000"
UBOOT_RD_ENTRYPOINT:pico-imx6ul = "0x83800000"
UBOOT_RD_LOADADDRESS:pico-imx6ul = "0x83800000"
UBOOT_FDT_LOADADDRESS:rescue = "0x83000000"
UBOOT_FDTOV_LOADADDRESS:rescue = "0x82FE0000"
UBOOT_FIT_LOADADDRESS:rescue = "0x87880000"
UBOOT_FIT_PREFIX:rescue = ""
```

## conf/machine/pico-imx7.conf
```bitbake
#@TYPE: Machine
#@NAME: pico-imx7
#@SOC: i.MX7/Solo/Dual/UtraLowPower
#@DESCRIPTION: Machine configuration for PICO-IMX7 with QCA(Qualcomm)/BRCM(Broadcom) WLAN module
#@MAINTAINER: Po Cheng <po.cheng@technexion.com>

MACHINEOVERRIDES =. "mx7:mx7d:"
MACHINEOVERRIDES_EXTENDER_pico-imx7 = "uenv"

include conf/machine/include/imx-base.inc
include conf/machine/include/tune-cortexa7.inc
require conf/machine/tn-base.inc

#
# Kernel Device Trees
#
PREFERRED_PROVIDER_virtual/kernel ?= "linux-tn-imx"
PREFERRED_PROVIDER_virtual/kernel_mx7 = "linux-tn-imx"

KERNEL_DEVICETREE = "imx7d-pico-pi-qca.dtb"
#					 imx7d-pico-pi.dtb \
#                     imx7d-pico-pi-c2-qca.dtb imx7d-pico-pi-c2.dtb \
#                     imx7d-pico-nymph-qca.dtb imx7d-pico-nymph.dtb \
#                     imx7d-pico-dwarf-qca.dtb imx7d-pico-dwarf.dtb \
#                     imx7d-pico-hobbit-qca.dtb imx7d-pico-hobbit.dtb \
#"

# Setup the additional devicetree file
#KERNEL_DEVICETREE_append_voicehat = " imx7d-pico-pi-qca-voicehat.dtb \
#                                      imx7d-pico-pi-voicehat.dtb \
#                                      imx7d-pico-pi-c2-qca-voicehat.dtb \
#                                      imx7d-pico-pi-c2-voicehat.dtb "

# Bootloader Specifics
UBOOT_MACHINE = "pico-imx7d_spl_defconfig"

#M4_MACHINE = "pico-imx7d-pi"
#IMAGE_BOOTFILES_DEPENDS += "imx-m4-demos-tn:do_deploy"
#IMAGE_BOOTFILES += "hello_world.bin rpmsg_lite_pingpong_rtos_linux_remote.bin rpmsg_lite_str_echo_rtos_imxcm4.bin"

# override extender for graphics libs
MACHINEOVERRIDES_EXTENDER_mx7d = "imxpxp:imxepdc"
# mx7 GPU libraries
PREFERRED_PROVIDER_virtual/egl_mx7d = "mesa"
PREFERRED_PROVIDER_virtual/libgles1_mx7d = "mesa"
PREFERRED_PROVIDER_virtual/libgles2_mx7d = "mesa"
PREFERRED_PROVIDER_virtual/libgl_mx7d = "mesa"
PREFERRED_PROVIDER_virtual/libg2d_mx7d = ""
# MESA DRI library
XSERVER += "mesa-driver-swrast"

# Peripherals
# Set Serial console
SERIAL_CONSOLE = "115200;ttymxc4"
SERIAL_BLUETOOTH = "3000000;ttymxc6"

# WIC Image
WIC_FSTAB_BLKDEV = "mmcblk2"
WIC_PARTITION_TABLE_TYPE ?= "msdos"

#do_image_wic[depends] += "imx-m4-demos-tn:do_deploy"
IMAGE_BOOT_FILES = "\
    ${KERNEL_IMAGETYPE} \
    ${KERNEL_DEVICETREE} \
    u-boot-${MACHINE}.${UBOOT_SUFFIX};u-boot-dtb.img \
"


# UBOOT entry address for fitImages
UBOOT_ENTRYPOINT_pico-imx7 = "0x80800000"
UBOOT_RD_ENTRYPOINT_pico-imx7 = "0x83800000"
UBOOT_RD_LOADADDRESS_pico-imx7 = "0x83800000"
UBOOT_FDT_LOADADDRESS_rescue = "0x83000000"
UBOOT_FDTOV_LOADADDRESS_rescue = "0x82FE0000"
UBOOT_FIT_LOADADDRESS_rescue = "0x87880000"
UBOOT_FIT_PREFIX_rescue = ""
```

## conf/machine/pico-imx8mm.conf
```bitbake
#@TYPE: Machine
#@NAME: PICO-IMX8MM
#@SOC: i.MX8MM
#@DESCRIPTION: Machine configuration for PICO-IMX8MM
#@MAINTAINER: Po Cheng <po.cheng@technexion.com>

MACHINEOVERRIDES =. "imx-boot-container:mx8mm:"

require conf/machine/include/imx-base.inc
require conf/machine/include/arm/armv8a/tune-cortexa53.inc
require conf/machine/tn-base.inc

# Kernel Device Trees
KERNEL_DEVICETREE:pico-imx8mm = "freescale/imx8mm-pico-pi.dtb \
                                 freescale/overlays/imx8mm-pico-pi-tevi-ap1302.dtbo \
                                 freescale/overlays/imx8mm-pico-pi-tevi-ov5640.dtbo \
				 freescale/overlays/imx8mm-pico-pi-ov5645.dtbo \
                                 freescale/overlays/imx8mm-pico-pi-ov7251.dtbo \
                                 freescale/imx8mm-pico-wizard.dtb \
                                 freescale/overlays/imx8mm-pico-pi-ili9881c.dtbo \
                                 freescale/overlays/imx8mm-pico-wizard-ili9881c.dtbo \
                                 freescale/overlays/imx8mm-pico-wizard-mipi2hdmi-adv7535.dtbo \
                                 freescale/overlays/imx8mm-pico-wizard-g080uan01.dtbo \
                                 freescale/overlays/imx8mm-pico-wizard-g101uan02.dtbo \
                                 freescale/overlays/imx8mm-pico-wizard-sn65dsi84-vl10112880.dtbo \
                                 freescale/overlays/imx8mm-pico-wizard-sn65dsi84-vl15613676.dtbo \
                                 freescale/overlays/imx8mm-pico-wizard-sn65dsi84-vl215192108.dtbo \
                                 freescale/overlays/imx8mm-pico-wizard-tevi-ov5640.dtbo \
				 freescale/overlays/imx8mm-pico-wizard-ov5645.dtbo \
                                 freescale/overlays/imx8mm-pico-wizard-ov7251.dtbo \
                                 "
#                                 \
#                                 freescale/imx8mm-pico-pi-m4.dtb \
#                                 freescale/imx8mm-pico-pi-ov7251.dtb \
#                                 freescale/imx8mm-pico-wizard-m4.dtb \
#"
# Setup the additional devicetree file
KERNEL_DEVICETREE:append:voicehat = " freescale/overlays/imx8mm-pico-pi-voicehat.dtbo \
                                      freescale/overlays/imx8mm-pico-wizard-voicehat.dtbo"

KERNEL_DEVICETREE:append:nfc = " freescale/overlays/imx8mm-pico-pi-clixnfc.dtbo \
                                 freescale/overlays/imx8mm-pico-wizard-clix1nfc.dtbo \
                                 freescale/overlays/imx8mm-pico-wizard-clix2nfc.dtbo"
#				 freescale/imx8mm-pico-pi-nfc.dtb"
#"
EXTRA_OEMAKE:append:pn-linux-tn-imx = " DTC_FLAGS='-@ -H epapr'"

M4_MACHINE = "pico-imx8mm-pi"
do_image_wic[depends] += "imx-m4-demos-tn:do_deploy"
IMAGE_BOOTFILES += "hello_world.bin rpmsg_lite_pingpong_rtos_linux_remote.bin rpmsg_lite_str_echo_rtos_imxcm4.bin"

# Bootloader Specifics
UBOOT_CONFIG[sd] = "pico-imx8mm_defconfig,sdcard"
UBOOT_CONFIG[mfgtool] = "pico-imx8mm_defconfig"

# Set u-boot DTB
UBOOT_DTB_NAME = "imx8mm-pico-pi.dtb imx8mm-pico-wizard.dtb"

ATF_PLATFORM = "imx8mm"
ATF_LOAD_ADDR = "0x920000"

# Extra firmware package name, that is required to build boot container for fslc bsp
IMX_EXTRA_FIRMWARE = "firmware-imx-8m"
IMX_BOOT_SOC_TARGET = "iMX8MM"

# Peripherals
# Set Serial console
SERIAL_CONSOLES = "115200;ttymxc1"
SERIAL_BLUETOOTH = "3000000;ttymxc0"

# WIC Image
WKS_FILE:virtualization = "tn-imx8-imxboot-rootfs-container.wks.in"
WIC_FSTAB_BLKDEV = "mmcblk2"
WIC_CREATE_EXTRA_ARGS:remove:virtualization = "--no-fstab-update"
WIC_PARTITION_TABLE_TYPE ?= "msdos"
IMAGE_FSTYPES:append:virtualization = " wic wic.xz wic.md5sum"
IMAGE_FSTYPES:remove:virtualization = " sdcard sdcard.bz2 sdcard.xz sdcard.md5sum"
IMAGE_BOOT_FILES += "\
    ${IMAGE_BOOTFILES} \
"

# virtualization - docker containers
#DOCKERDISKDEPENDS = "${@bb.utils.contains('DISTRO_FEATURES', 'virtualization', 'docker-disk:do_deploy', '', d)}"
#do_image_wic[depends] += "imx-m4-demos-tn:do_deploy ${DOCKERDISKDEPENDS}"
#TN_DOCKER_PARTITION_IMAGE = "docker-data-partition.img"
#TN_DOCKER_PARTITION_MOUNT = "/var/lib/docker"
#TN_DOCKER_PARTITION_SIZE = "4096"
```
